## sdkconfig.defaults
```kconfig
CONFIG_IDF_TARGET="esp32c3"

# FREERTOS
CONFIG_FREERTOS_HZ=1000

# to disable checking CPU1 IDLE Task in Dual Core CPU
CONFIG_TASK_WDT_CHECK_IDLE_TASK_CPU1=n

# set flash size
CONFIG_ESPTOOLPY_FLASHSIZE_4MB=y
CONFIG_ESPTOOLPY_FLASHSIZE="4MB"

CONFIG_PARTITION_TABLE_CUSTOM=y
CONFIG_PARTITION_TABLE_FILENAME="partitions.csv"


# to kill warning
# TLS Key Exchange Methods
#
CONFIG_MBEDTLS_PSK_MODES=y
CONFIG_MBEDTLS_KEY_EXCHANGE_PSK=y
CONFIG_MBEDTLS_KEY_EXCHANGE_ECDHE_PSK=y
CONFIG_MBEDTLS_KEY_EXCHANGE_RSA_PSK=y
```
